## Config.in
```kconfig
source "$BR2_EXTERNAL_SPINAL_SAXON_PATH/package/opensbi-ext/Config.in"
source "$BR2_EXTERNAL_SPINAL_SAXON_PATH/package/mandelbrot/Config.in"
source "$BR2_EXTERNAL_SPINAL_SAXON_PATH/package/berkeley-float/Config.in"
source "$BR2_EXTERNAL_SPINAL_SAXON_PATH/package/wmaker/Config.in"
source "$BR2_EXTERNAL_SPINAL_SAXON_PATH/package/openttd/Config.in"
source "$BR2_EXTERNAL_SPINAL_SAXON_PATH/package/dockapps/Config.in"
source "$BR2_EXTERNAL_SPINAL_SAXON_PATH/package/wmmand/Config.in"
source "$BR2_EXTERNAL_SPINAL_SAXON_PATH/package/alsaplayer/Config.in"

config BR2_PACKAGE_VEXRISCV_AES
	bool "VexRiscv AES custom instruction"
	help
	  Enable VexRiscv AES custom instruction usage in libressl
```

## boards/spinal-saxon/arty-a7-smp/linux/linux_defconfig
```kconfig
CONFIG_BLK_DEV_INITRD=y
CONFIG_ARCH_RV32I=y
CONFIG_CMODEL_MEDANY=y
CONFIG_SMP=y
# CONFIG_RISCV_ISA_C is not set
# CONFIG_EFI is not set
# CONFIG_COMPAT_32BIT_TIME is not set
# CONFIG_STRICT_KERNEL_RWX is not set
# CONFIG_GCC_PLUGINS is not set
CONFIG_MODULES=y
CONFIG_IOSCHED_BFQ=y
CONFIG_NET=y
CONFIG_PACKET=y
CONFIG_PACKET_DIAG=y
CONFIG_UNIX=y
CONFIG_INET=y
CONFIG_IP_PNP=y
CONFIG_IP_PNP_DHCP=y
CONFIG_DEVTMPFS=y
CONFIG_DEVTMPFS_MOUNT=y
CONFIG_MTD=y
CONFIG_MTD_SPI_NOR=y
CONFIG_NETDEVICES=y
# CONFIG_NET_VENDOR_ALACRITECH is not set
# CONFIG_NET_VENDOR_AMAZON is not set
# CONFIG_NET_VENDOR_AQUANTIA is not set
# CONFIG_NET_VENDOR_ARC is not set
# CONFIG_NET_VENDOR_AURORA is not set
# CONFIG_NET_VENDOR_BROADCOM is not set
# CONFIG_NET_VENDOR_CADENCE is not set
# CONFIG_NET_VENDOR_CAVIUM is not set
# CONFIG_NET_VENDOR_CORTINA is not set
# CONFIG_NET_VENDOR_EZCHIP is not set
# CONFIG_NET_VENDOR_GOOGLE is not set
# CONFIG_NET_VENDOR_HUAWEI is not set
# CONFIG_NET_VENDOR_INTEL is not set
# CONFIG_NET_VENDOR_MARVELL is not set
# CONFIG_NET_VENDOR_MICREL is not set
# CONFIG_NET_VENDOR_MICROCHIP is not set
# CONFIG_NET_VENDOR_MICROSEMI is not set
# CONFIG_NET_VENDOR_NATSEMI is not set
# CONFIG_NET_VENDOR_NETRONOME is not set
# CONFIG_NET_VENDOR_NI is not set
# CONFIG_NET_VENDOR_PENSANDO is not set
# CONFIG_NET_VENDOR_QUALCOMM is not set
# CONFIG_NET_VENDOR_RENESAS is not set
# CONFIG_NET_VENDOR_ROCKER is not set
# CONFIG_NET_VENDOR_SAMSUNG is not set
# CONFIG_NET_VENDOR_SEEQ is not set
# CONFIG_NET_VENDOR_SOLARFLARE is not set
# CONFIG_NET_VENDOR_SOCIONEXT is not set
CONFIG_NET_VENDOR_SPINAL=y
CONFIG_SPINAL_LIB_MAC=y
# CONFIG_NET_VENDOR_STMICRO is not set
# CONFIG_NET_VENDOR_SYNOPSYS is not set
# CONFIG_NET_VENDOR_VIA is not set
# CONFIG_NET_VENDOR_WIZNET is not set
# CONFIG_NET_VENDOR_XILINX is not set
# CONFIG_LEGACY_PTYS is not set
CONFIG_SERIAL_EARLYCON_RISCV_SBI=y
CONFIG_SERIAL_SPINAL_LIB=y
CONFIG_SERIAL_SPINAL_LIB_CONSOLE=y
CONFIG_HVC_RISCV_SBI=y
CONFIG_I2C=y
CONFIG_I2C_CHARDEV=y
CONFIG_I2C_GPIO=y
CONFIG_SPI=y
CONFIG_SPI_SPINAL_LIB=y
CONFIG_SPI_SPIDEV=y
CONFIG_GPIOLIB=y
CONFIG_GPIO_SYSFS=y
CONFIG_GPIO_SPINAL_LIB=y
# CONFIG_HWMON is not set
CONFIG_FB=y
CONFIG_FB_SIMPLE=y
CONFIG_FRAMEBUFFER_CONSOLE=y
CONFIG_SOUND=y
CONFIG_SND=y
# CONFIG_SND_SPI is not set
CONFIG_SND_SPINAL_LIB_AUDIO_OUT=y
# CONFIG_USB_SUPPORT is not set
CONFIG_MMC=y
CONFIG_MMC_SPI=y
CONFIG_NEW_LEDS=y
CONFIG_LEDS_CLASS=y
CONFIG_LEDS_CLASS_FLASH=y
CONFIG_LEDS_GPIO=y
CONFIG_LEDS_USER=y
CONFIG_LEDS_TRIGGERS=y
CONFIG_LEDS_TRIGGER_TIMER=y
CONFIG_LEDS_TRIGGER_ONESHOT=y
CONFIG_LEDS_TRIGGER_MTD=y
CONFIG_LEDS_TRIGGER_HEARTBEAT=y
CONFIG_LEDS_TRIGGER_BACKLIGHT=y
CONFIG_LEDS_TRIGGER_CPU=y
CONFIG_LEDS_TRIGGER_ACTIVITY=y
CONFIG_LEDS_TRIGGER_DEFAULT_ON=y
CONFIG_DMADEVICES=y
CONFIG_SPINAL_LIB_DMASG=y
# CONFIG_VIRTIO_MENU is not set
# CONFIG_VHOST_MENU is not set
# CONFIG_IOMMU_SUPPORT is not set
CONFIG_SIFIVE_PLIC=y
# CONFIG_NVMEM is not set
CONFIG_EXT2_FS=y
CONFIG_EXT2_FS_XATTR=y
CONFIG_EXT2_FS_POSIX_ACL=y
CONFIG_EXT2_FS_SECURITY=y
CONFIG_MSDOS_FS=y
CONFIG_VFAT_FS=y
CONFIG_TMPFS=y
CONFIG_NFS_FS=y
CONFIG_ROOT_NFS=y
CONFIG_NLS_CODEPAGE_437=y
CONFIG_NLS_ASCII=y
CONFIG_NLS_ISO8859_1=y
CONFIG_PRINTK_TIME=y
CONFIG_FRAME_WARN=2048
```

## boards/spinal-saxon/arty-a7-smp/u-boot/saxon_bsp_defconfig
```kconfig
CONFIG_RISCV=y
CONFIG_SYS_TEXT_BASE=0x81F00000
CONFIG_SYS_MALLOC_F_LEN=0x8000
CONFIG_NR_DRAM_BANKS=1
CONFIG_DEBUG_UART_BASE=0x10010000
CONFIG_DEBUG_UART_CLOCK=100000000
CONFIG_DEFAULT_DEVICE_TREE="saxon_bsp"
CONFIG_DEBUG_UART=y
CONFIG_TARGET_VEXRISCV_SAXON=y
CONFIG_RISCV_SMODE=y
# CONFIG_RISCV_ISA_C is not set
CONFIG_SBI_V02=y
CONFIG_DISTRO_DEFAULTS=y
CONFIG_BOOTCOMMAND="bootm 0x80000000 0x81FFFFC0 0x81FF0000"
CONFIG_CMD_MMC=y
CONFIG_CMD_SPI=y
CONFIG_CMD_TIMER=y
CONFIG_CMD_EXT4_WRITE=y
CONFIG_OF_EMBED=y
CONFIG_ENV_IS_IN_FAT=y
CONFIG_ENV_FAT_DEVICE_AND_PART="0:1"
CONFIG_ENV_FAT_FILE="/uboot.env"
CONFIG_MMC=y
CONFIG_MMC_BROKEN_CD=y
CONFIG_MMC_SPI=y
CONFIG_VEXRISCV_SERIAL=y
CONFIG_SPI=y
CONFIG_VEXRISCV_SPI=y
```

## boards/spinal-saxon/nexys-a7-smp/u-boot/uboot_defconfig
```kconfig
CONFIG_RISCV=y
CONFIG_SYS_TEXT_BASE=0x80F00000
CONFIG_SYS_MALLOC_F_LEN=0x8000
CONFIG_NR_DRAM_BANKS=1
CONFIG_DEBUG_UART_BASE=0x10010000
CONFIG_DEBUG_UART_CLOCK=100000000
CONFIG_DEFAULT_DEVICE_TREE="uboot"
CONFIG_DEBUG_UART=y
CONFIG_TARGET_VEXRISCV_SAXON=y
CONFIG_RISCV_SMODE=y
# CONFIG_RISCV_ISA_C is not set
CONFIG_SBI_V02=y
CONFIG_DISTRO_DEFAULTS=y
CONFIG_BOOTCOMMAND="dhcp;setenv pxefile_addr_r 81000000;setenv kernel_addr_r 80000000;setenv ramdisk_addr_r 80ffffc0;setenv fdt_addr_r 80ff0000;pxe get;pxe boot"
CONFIG_CMD_MMC=y
CONFIG_CMD_SPI=y
CONFIG_CMD_TIMER=y
CONFIG_CMD_EXT4_WRITE=y
CONFIG_OF_EMBED=y
CONFIG_ENV_IS_IN_FAT=y
CONFIG_ENV_FAT_DEVICE_AND_PART="0:1"
CONFIG_ENV_FAT_FILE="/uboot.env"
CONFIG_NET_RANDOM_ETHADDR=y
CONFIG_MMC=y
CONFIG_MMC_BROKEN_CD=y
CONFIG_MMC_SPI=y
CONFIG_SPINAL_LIB_MAC=y
CONFIG_VEXRISCV_SERIAL=y
CONFIG_SPI=y
CONFIG_VEXRISCV_SPI=y
```

## boards/spinal-saxon/ulx3s/u-boot/uboot_defconfig
```kconfig
CONFIG_RISCV=y
CONFIG_SYS_TEXT_BASE=0x81000000
CONFIG_SYS_MALLOC_F_LEN=0x8000
CONFIG_NR_DRAM_BANKS=1
CONFIG_DEBUG_UART_BASE=0x10010000
CONFIG_DEBUG_UART_CLOCK=52000000
CONFIG_DEFAULT_DEVICE_TREE="uboot"
CONFIG_DEBUG_UART=y
CONFIG_TARGET_VEXRISCV_SAXON=y
CONFIG_RISCV_SMODE=y
# CONFIG_RISCV_ISA_C is not set
CONFIG_SBI_V02=y
CONFIG_DISTRO_DEFAULTS=y
CONFIG_BOOTCOMMAND="load mmc 0:1 0x80000000 uImage;load mmc 0:1 0x80FF0000 linux.dtb;bootm 0x80000000 - 0x80FF0000"
CONFIG_CMD_MMC=y
CONFIG_CMD_SPI=y
CONFIG_CMD_TIMER=y
CONFIG_CMD_EXT4_WRITE=y
CONFIG_OF_EMBED=y
CONFIG_NET_RANDOM_ETHADDR=y
CONFIG_MMC=y
CONFIG_MMC_BROKEN_CD=y
CONFIG_MMC_SPI=y
CONFIG_SPINAL_LIB_MAC=y
CONFIG_VEXRISCV_SERIAL=y
CONFIG_SPI=y
CONFIG_VEXRISCV_SPI=y

# ENV in SDCARD
#CONFIG_ENV_IS_IN_FAT=y
#CONFIG_ENV_FAT_INTERFACE="mmc"
#CONFIG_ENV_FAT_DEVICE_AND_PART="0:1"
#CONFIG_ENV_FAT_FILE="/uboot.env"

CONFIG_ENV_IS_IN_SPI_FLASH=y
CONFIG_CMD_SPI=y
CONFIG_DM_SPI=y
CONFIG_MTD=y
CONFIG_CMD_MTD=y
CONFIG_DM_MTD=y
CONFIG_DM_SPI_FLASH=y
CONFIG_SPI_FLASH_MTD=y
CONFIG_SPI_FLASH_SFDP_SUPPORT=y
CONFIG_SPI_FLASH_WINBOND=y
CONFIG_SPI_FLASH_ISSI=y
CONFIG_SPI_FLASH_SPANSION=y

CONFIG_MTDIDS_DEFAULT="nor0=fpga-flash"
CONFIG_MTDPARTS_DEFAULT="mtdparts=fpga-flash:3200k(fpga_bitstream),128k(uboot-env),128k(opensbi),640k(uboot)"
CONFIG_ENV_SIZE=0x10000
CONFIG_ENV_OFFSET=0x320000

CONFIG_CMD_USB=y
CONFIG_USB=y
CONFIG_DM_USB=y
CONFIG_DM_USB_GADGET=y
CONFIG_USB_OHCI_HCD=y
CONFIG_USB_OHCI_GENERIC=y
```

## configs/saxon_arty_a7_35_defconfig
```kconfig
BR2_riscv=y
BR2_riscv_custom=y
BR2_RISCV_ISA_CUSTOM_RVM=y
BR2_RISCV_ISA_CUSTOM_RVF=y
BR2_RISCV_ISA_CUSTOM_RVD=y
BR2_RISCV_ISA_CUSTOM_RVC=y
BR2_RISCV_32=y
BR2_CCACHE=y
BR2_CCACHE_DIR="$(HOME)/.buildroot-ccache-saxon_default"
BR2_GLOBAL_PATCH_DIR="$(BR2_EXTERNAL_SPINAL_SAXON_PATH)/patches/"
BR2_PER_PACKAGE_DIRECTORIES=y
BR2_BINUTILS_VERSION_2_33_X=y
BR2_GCC_VERSION_10_X=y
BR2_TOOLCHAIN_BUILDROOT_CXX=y
BR2_TARGET_GENERIC_GETTY_PORT="hvc0"
BR2_SYSTEM_DHCP="eth0"
BR2_ROOTFS_OVERLAY="${BR2_EXTERNAL_SPINAL_SAXON_PATH}/boards/common/rootfs_overlay ${SAXON_BUILDROOT_USER_OVERLAY}"
BR2_ROOTFS_POST_BUILD_SCRIPT="$(BR2_EXTERNAL_SPINAL_SAXON_PATH)/boards/common/post_build.sh"
BR2_ROOTFS_POST_IMAGE_SCRIPT="$(BR2_EXTERNAL_SPINAL_SAXON_PATH)/boards/common/post_create_fs.sh"
BR2_ROOTFS_POST_SCRIPT_ARGS="spinal-saxon/arty-a7-smp"
BR2_LINUX_KERNEL=y
BR2_LINUX_KERNEL_CUSTOM_GIT=y
BR2_LINUX_KERNEL_CUSTOM_REPO_URL="https://github.com/SpinalHDL/linux.git"
BR2_LINUX_KERNEL_CUSTOM_REPO_VERSION="spinal-v5.10.1"
BR2_LINUX_KERNEL_USE_CUSTOM_CONFIG=y
BR2_LINUX_KERNEL_CUSTOM_CONFIG_FILE="$(BR2_EXTERNAL_SPINAL_SAXON_PATH)/boards/spinal-saxon/arty-a7-smp/linux/linux_defconfig"
BR2_LINUX_KERNEL_DTS_SUPPORT=y
BR2_LINUX_KERNEL_CUSTOM_DTS_PATH="$(BR2_EXTERNAL_SPINAL_SAXON_PATH)/boards/spinal-saxon/arty-a7-smp/linux/linux.dts"
BR2_PACKAGE_BUSYBOX_SHOW_OTHERS=y
BR2_PACKAGE_ALSA_UTILS=y
BR2_PACKAGE_ALSA_UTILS_ALSACONF=y
BR2_PACKAGE_ALSA_UTILS_AMIXER=y
BR2_PACKAGE_ALSA_UTILS_APLAY=y
BR2_PACKAGE_ALSA_UTILS_SPEAKER_TEST=y
BR2_PACKAGE_MPG123=y
BR2_PACKAGE_DHRYSTONE=y
BR2_PACKAGE_MTD=y
BR2_PACKAGE_MTD_TESTS=y
BR2_PACKAGE_MTD_FLASH_SPEED=y
BR2_PACKAGE_MTD_FLASH_TORTURE=y
BR2_PACKAGE_DEJAVU=y
BR2_PACKAGE_HICOLOR_ICON_THEME=y
BR2_PACKAGE_LBREAKOUT2=y
# BR2_PACKAGE_LBREAKOUT2_AUDIO is not set
# BR2_PACKAGE_LBREAKOUT2_NET is not set
BR2_PACKAGE_LTRIS=y
# BR2_PACKAGE_LTRIS_AUDIO is not set
BR2_PACKAGE_OPENTYRIAN=y
# BR2_PACKAGE_OPENTYRIAN_NET is not set
BR2_PACKAGE_PRBOOM=y
BR2_PACKAGE_SL=y
BR2_PACKAGE_DIRECTFB=y
# BR2_PACKAGE_DIRECTFB_DEBUG_SUPPORT is not set
BR2_PACKAGE_DIRECTFB_TIFF=y
BR2_PACKAGE_SDL_DIRECTFB=y
BR2_PACKAGE_SDL_X11=y
BR2_PACKAGE_SDL_SOUND=y
BR2_PACKAGE_SDL_TTF=y
BR2_PACKAGE_XORG7=y
BR2_PACKAGE_XSERVER_XORG_SERVER=y
BR2_PACKAGE_XAPP_SETXKBMAP=y
BR2_PACKAGE_XAPP_TWM=y
BR2_PACKAGE_XAPP_XCALC=y
BR2_PACKAGE_XAPP_XCLOCK=y
BR2_PACKAGE_XAPP_XDPYINFO=y
BR2_PACKAGE_XAPP_XEYES=y
BR2_PACKAGE_XAPP_XINIT=y
BR2_PACKAGE_XAPP_XINPUT=y
BR2_PACKAGE_XAPP_XKILL=y
BR2_PACKAGE_XAPP_XLOAD=y
BR2_PACKAGE_XAPP_XMODMAP=y
BR2_PACKAGE_XAPP_XREFRESH=y
BR2_PACKAGE_XAPP_XWD=y
BR2_PACKAGE_XAPP_XWININFO=y
BR2_PACKAGE_XDRIVER_XF86_INPUT_KEYBOARD=y
BR2_PACKAGE_XDRIVER_XF86_INPUT_MOUSE=y
BR2_PACKAGE_XDRIVER_XF86_VIDEO_FBDEV=y
BR2_PACKAGE_ALSAMIXERGUI=y
BR2_PACKAGE_DILLO=y
BR2_PACKAGE_FEH=y
BR2_PACKAGE_LEAFPAD=y
BR2_PACKAGE_PCMANFM=y
BR2_PACKAGE_XDOTOOL=y
BR2_PACKAGE_XSCREENSAVER=y
BR2_PACKAGE_XTERM=y
BR2_PACKAGE_DBUS_GLIB=y
BR2_PACKAGE_GVFS=y
BR2_PACKAGE_LIBID3TAG=y
BR2_PACKAGE_LIBMAD=y
BR2_PACKAGE_LZ4=y
BR2_PACKAGE_LZO=y
BR2_PACKAGE_LIBRESSL=y
BR2_PACKAGE_LIBRESSL_BIN=y
BR2_PACKAGE_GLIB_NETWORKING=y
BR2_PACKAGE_LIBCURL=y
BR2_PACKAGE_LIBCURL_CURL=y
BR2_PACKAGE_HAVEGED=y
BR2_PACKAGE_DROPBEAR=y
BR2_PACKAGE_IPERF3=y
BR2_PACKAGE_SSHPASS=y
BR2_PACKAGE_BASH=y
BR2_PACKAGE_DIALOG=y
BR2_PACKAGE_CPULOAD=y
BR2_PACKAGE_HTOP=y
BR2_PACKAGE_UTIL_LINUX_SCHEDUTILS=y
BR2_PACKAGE_NANO=y
BR2_TARGET_ROOTFS_CPIO=y
BR2_TARGET_ROOTFS_CPIO_UIMAGE=y
BR2_TARGET_ROOTFS_EXT2=y
BR2_TARGET_ROOTFS_EXT2_SIZE="250M"
BR2_TARGET_OPENSBI=y
BR2_TARGET_OPENSBI_PLAT="out-of-tree"
BR2_TARGET_UBOOT=y
BR2_TARGET_UBOOT_BUILD_SYSTEM_KCONFIG=y
BR2_TARGET_UBOOT_CUSTOM_GIT=y
BR2_TARGET_UBOOT_CUSTOM_REPO_URL="https://github.com/SpinalHDL/u-boot.git"
BR2_TARGET_UBOOT_CUSTOM_REPO_VERSION="smp-latest"
BR2_TARGET_UBOOT_USE_CUSTOM_CONFIG=y
BR2_TARGET_UBOOT_CUSTOM_CONFIG_FILE="$(BR2_EXTERNAL_SPINAL_SAXON_PATH)/boards/spinal-saxon/arty-a7-smp/u-boot/uboot_defconfig"
BR2_TARGET_UBOOT_CUSTOM_DTS_PATH="$(BR2_EXTERNAL_SPINAL_SAXON_PATH)/boards/spinal-saxon/arty-a7-smp/u-boot/uboot.dts"
BR2_PACKAGE_HOST_GENIMAGE=y
BR2_TARGET_OPENSBI_PLAT_PATH="$(BR2_EXTERNAL_SPINAL_SAXON_PATH)/boards/spinal-saxon/arty-a7-smp/opensbi"
BR2_PACKAGE_MANDELBROT=y
BR2_PACKAGE_BERKELEY_FLOAT=y
BR2_PACKAGE_WMAKER=y
BR2_PACKAGE_OPENTTD=y
BR2_PACKAGE_DOCKAPPS=y
BR2_PACKAGE_WMMAND=y
BR2_PACKAGE_VEXRISCV_AES=y
```

## configs/saxon_nexys_a7_100_defconfig
```kconfig
BR2_riscv=y
BR2_riscv_custom=y
BR2_RISCV_ISA_CUSTOM_RVM=y
BR2_RISCV_32=y
BR2_CCACHE=y
BR2_CCACHE_DIR="$(HOME)/.buildroot-ccache-saxon_default"
BR2_PER_PACKAGE_DIRECTORIES=y
BR2_BINUTILS_VERSION_2_33_X=y
BR2_GCC_VERSION_10_X=y
BR2_TOOLCHAIN_BUILDROOT_CXX=y
BR2_TARGET_GENERIC_GETTY_PORT="hvc0"
BR2_SYSTEM_DHCP="eth0"
BR2_ROOTFS_OVERLAY="${BR2_EXTERNAL_SPINAL_SAXON_PATH}/boards/common/rootfs_overlay"
BR2_ROOTFS_POST_BUILD_SCRIPT="$(BR2_EXTERNAL_SPINAL_SAXON_PATH)/boards/common/post_build.sh"
BR2_ROOTFS_POST_IMAGE_SCRIPT="$(BR2_EXTERNAL_SPINAL_SAXON_PATH)/boards/common/post_create_fs.sh"
BR2_ROOTFS_POST_SCRIPT_ARGS="spinal-saxon/nexys-a7-smp"
BR2_LINUX_KERNEL=y
BR2_LINUX_KERNEL_CUSTOM_GIT=y
BR2_LINUX_KERNEL_CUSTOM_REPO_URL="https://github.com/SpinalHDL/linux.git"
BR2_LINUX_KERNEL_CUSTOM_REPO_VERSION="dev"
BR2_LINUX_KERNEL_USE_CUSTOM_CONFIG=y
BR2_LINUX_KERNEL_CUSTOM_CONFIG_FILE="$(BR2_EXTERNAL_SPINAL_SAXON_PATH)/boards/spinal-saxon/nexys-a7-smp/linux/linux_defconfig"
BR2_LINUX_KERNEL_DTS_SUPPORT=y
BR2_LINUX_KERNEL_CUSTOM_DTS_PATH="$(BR2_EXTERNAL_SPINAL_SAXON_PATH)/boards/spinal-saxon/nexys-a7-smp/linux/linux.dts"
BR2_PACKAGE_ALSA_UTILS=y
BR2_PACKAGE_ALSA_UTILS_ALSACONF=y
BR2_PACKAGE_ALSA_UTILS_AMIXER=y
BR2_PACKAGE_ALSA_UTILS_APLAY=y
BR2_PACKAGE_ALSA_UTILS_SPEAKER_TEST=y
BR2_PACKAGE_MPG123=y
BR2_PACKAGE_DHRYSTONE=y
BR2_PACKAGE_MTD=y
BR2_PACKAGE_MTD_TESTS=y
BR2_PACKAGE_MTD_FLASH_SPEED=y
BR2_PACKAGE_MTD_FLASH_TORTURE=y
BR2_PACKAGE_SL=y
BR2_PACKAGE_LIBID3TAG=y
BR2_PACKAGE_LIBMAD=y
BR2_PACKAGE_LZ4=y
BR2_PACKAGE_LZO=y
BR2_PACKAGE_DROPBEAR=y
BR2_PACKAGE_IPERF3=y
BR2_PACKAGE_SSHPASS=y
BR2_PACKAGE_HTOP=y
BR2_TARGET_ROOTFS_CPIO=y
BR2_TARGET_ROOTFS_CPIO_UIMAGE=y
BR2_TARGET_ROOTFS_EXT2=y
BR2_TARGET_OPENSBI=y
BR2_TARGET_OPENSBI_PLAT="out-of-tree"
BR2_TARGET_UBOOT=y
BR2_TARGET_UBOOT_BUILD_SYSTEM_KCONFIG=y
BR2_TARGET_UBOOT_CUSTOM_GIT=y
BR2_TARGET_UBOOT_CUSTOM_REPO_URL="https://github.com/SpinalHDL/u-boot.git"
BR2_TARGET_UBOOT_CUSTOM_REPO_VERSION="smp-latest"
BR2_TARGET_UBOOT_USE_CUSTOM_CONFIG=y
BR2_TARGET_UBOOT_CUSTOM_CONFIG_FILE="$(BR2_EXTERNAL_SPINAL_SAXON_PATH)/boards/spinal-saxon/nexys-a7-smp/u-boot/uboot_defconfig"
BR2_TARGET_UBOOT_CUSTOM_DTS_PATH="$(BR2_EXTERNAL_SPINAL_SAXON_PATH)/boards/spinal-saxon/nexys-a7-smp/u-boot/uboot.dts"
BR2_PACKAGE_HOST_GENIMAGE=y
BR2_TARGET_OPENSBI_PLAT_PATH="$(BR2_EXTERNAL_SPINAL_SAXON_PATH)/boards/spinal-saxon/nexys-a7-smp/opensbi"
```

## package/alsaplayer/Config.in
```kconfig
config BR2_PACKAGE_ALSAPLAYER
	bool "alsaplayer"
	select BR2_PACKAGE_LIBMAD
	help
	  AlsaPlayer package.
```

## package/berkeley-float/Config.in
```kconfig
config BR2_PACKAGE_BERKELEY_FLOAT
	bool "berkeley-float"
	help
	  Berkeley-float package.

	  http://example.com
```

## package/gpio-interrupt/Config.in
```kconfig
config BR2_PACKAGE_GPIO_INTERRUPT
	bool "gpio-interrupt"
	help
	  Can be used to test gpio interrupts
```

## package/mandelbrot/Config.in
```kconfig
config BR2_PACKAGE_MANDELBROT
	bool "mandelbrot"
	help
	  Mandelbrot package.

	  http://example.com
```

## package/openttd/Config.in
```kconfig
config BR2_PACKAGE_OPENTTD
	bool "openttd"
	select BR2_PACKAGE_LIBZLIB
	select BR2_PACKAGE_LIBPNG
	select BR2_PACKAGE_SDL
	select BR2_PACKAGE_FREETYPE
	select BR2_PACKAGE_FONTCONFIG
	select BR2_PACKAGE_ICU
	select BR2_PACKAGE_OPENTTDH
	select BR2_PACKAGE_XZ
	help
	  OpenTTD package.
```

## package/wmaker/Config.in
```kconfig
config BR2_PACKAGE_WMAKER
	bool "wmaker"
	select BR2_PACKAGE_XLIB_LIBXFT
	select BR2_PACKAGE_XLIB_LIBXMU
	help
	  WindowMaker package.

	  http://example.com
```
